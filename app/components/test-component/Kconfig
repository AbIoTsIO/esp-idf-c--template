## app/components/test-component/Kconfig
```kconfig
menu "Abiots Test component"
    
    config ABIOTS_TEST_NAME
        string "A test name for this component"
        default ""
        help
            Default will include this in the project.

endmenu # ABiots Test Component
```
